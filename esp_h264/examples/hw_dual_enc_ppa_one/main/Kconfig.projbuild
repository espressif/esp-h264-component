## esp_h264/examples/hw_dual_enc_ppa_one/main/Kconfig.projbuild
```kconfig
menu "Example Configuration"

    config EXAMPLE_SRC_WIDTH
        int "Generator width (pixels)"
        default 1920
        range 80 1920
        help
            Width of the single generator frame. Must be even and a multiple of 16.
            1080P uses 1920x1088 (1080 rounded up to a multiple of 16).

    config EXAMPLE_SRC_HEIGHT
        int "Generator height (pixels)"
        default 1088
        range 80 2032
        help
            Height of the single generator frame. Must be even and a multiple of 16.

    config EXAMPLE_PPA_SCALE_NUM
        int "PPA scale numerator"
        default 1
        range 1 16
        help
            Stream 0 is PPA-scaled by NUM/DEN. Stream 1 keeps the generator resolution.

    config EXAMPLE_PPA_SCALE_DEN
        int "PPA scale denominator"
        default 2
        range 1 16
        help
            Stream 0 output size is SRC * NUM / DEN. PPA quantizes the ratio to 1/16
            and, for YUV420, an even fragment. That size must equal SRC * NUM / DEN,
            be a multiple of 16, and be at least 80.

    config EXAMPLE_GEN_REALTIME
        bool "Fill generator frames in realtime"
        default n
        help
            Y: rewrite the color-bar every frame (motion).
            N: fill GEN_SLOTS frames once, then recycle them (encode/PPA throughput).

    config EXAMPLE_ENC_FPS
        int "Signaled encoder FPS"
        default 30
        range 1 255

    config EXAMPLE_ENC_GOP
        int "Encoder GOP (same for both streams)"
        default 30
        range 1 255

    config EXAMPLE_RUN_SECONDS
        int "Measurement duration (seconds)"
        default 8
        range 1 600

endmenu
```

## esp_h264/examples/hw_dual_enc_ppa_one/sdkconfig.defaults
```kconfig
CONFIG_FREERTOS_HZ=1000
CONFIG_ESP_TASK_WDT_EN=n
CONFIG_SPIRAM=y
CONFIG_SPIRAM_SPEED_250M=y
CONFIG_ESP_DEFAULT_CPU_FREQ_MHZ_400=y
CONFIG_IDF_EXPERIMENTAL_FEATURES=y
CONFIG_ESP_MAIN_TASK_STACK_SIZE=10240
CONFIG_ESP_CONSOLE_USB_SERIAL_JTAG=y
CONFIG_EXAMPLE_SRC_WIDTH=1920
CONFIG_EXAMPLE_SRC_HEIGHT=1088
CONFIG_EXAMPLE_PPA_SCALE_NUM=1
CONFIG_EXAMPLE_PPA_SCALE_DEN=2
CONFIG_EXAMPLE_ENC_FPS=30
CONFIG_EXAMPLE_ENC_GOP=30
CONFIG_EXAMPLE_RUN_SECONDS=8
# CONFIG_EXAMPLE_GEN_REALTIME is not set
```

## esp_h264/examples/hw_dual_enc_two_gen/main/Kconfig.projbuild
```kconfig
menu "Example Configuration"

    config EXAMPLE_SRC0_WIDTH
        int "Generator 0 width (pixels)"
        default 1920
        range 80 1920

    config EXAMPLE_SRC0_HEIGHT
        int "Generator 0 height (pixels)"
        default 1088
        range 80 2032

    config EXAMPLE_SRC1_WIDTH
        int "Generator 1 width (pixels)"
        default 960
        range 80 1920

    config EXAMPLE_SRC1_HEIGHT
        int "Generator 1 height (pixels)"
        default 544
        range 80 2032

    config EXAMPLE_GEN_REALTIME
        bool "Fill generator frames in realtime"
        default y
        help
            Y: rewrite the color-bar every frame (motion).
            N: fill GEN_SLOTS frames once, then recycle them (encode throughput).

    config EXAMPLE_ENC_FPS
        int "Signaled encoder FPS"
        default 30
        range 1 255

    config EXAMPLE_ENC_GOP
        int "Encoder GOP (same for both streams)"
        default 30
        range 1 255

    config EXAMPLE_RUN_SECONDS
        int "Measurement duration (seconds)"
        default 8
        range 1 60

endmenu
```

## esp_h264/examples/hw_roi_encode/main/Kconfig.projbuild
```kconfig
menu "Example Configuration"

    config EXAMPLE_SRC_WIDTH
        int "Generator width (pixels)"
        default 1920
        range 80 1920
        help
            Width of the generator frame. Must be even and a multiple of 16.
            1080P uses 1920x1088 (1080 rounded up to a multiple of 16).

    config EXAMPLE_SRC_HEIGHT
        int "Generator height (pixels)"
        default 1088
        range 80 2032
        help
            Height of the generator frame. Must be even and a multiple of 16.

    config EXAMPLE_GEN_REALTIME
        bool "Fill generator frames in realtime"
        default y
        help
            Y: rewrite the color-bar every frame (motion).
            N: fill GEN_SLOTS frames once, then recycle them (encode throughput).

    choice EXAMPLE_ROI_MODE
        prompt "ROI mode"
        default EXAMPLE_ROI_MODE_FIX_QP
        help
            Hardware H.264 ROI: lower QP in a center region, raise QP outside.

        config EXAMPLE_ROI_MODE_FIX_QP
            bool "Fixed QP in ROI"

        config EXAMPLE_ROI_MODE_DELTA_QP
            bool "Delta QP in ROI (added to slice QP)"

        config EXAMPLE_ROI_MODE_DISABLE
            bool "Disable ROI"
    endchoice

    config EXAMPLE_ROI_QP
        int "ROI region QP / delta QP"
        default 20
        range -51 51
        help
            FIX_QP: absolute QP in [0, 51]. DELTA_QP: added to slice QP, range [-51, 51].

    config EXAMPLE_NONE_ROI_DELTA_QP
        int "Non-ROI delta QP"
        default 12
        range -51 51
        help
            Added to slice QP for the area outside the ROI.

    config EXAMPLE_ENC_FPS
        int "Signaled encoder FPS"
        default 30
        range 1 255

    config EXAMPLE_ENC_GOP
        int "Encoder GOP"
        default 30
        range 1 255

    config EXAMPLE_RUN_SECONDS
        int "Measurement duration (seconds)"
        default 8
        range 1 60

endmenu
```

## esp_h264/examples/hw_roi_encode/sdkconfig.defaults.esp32p4
```kconfig
CONFIG_ESPTOOLPY_FLASHMODE_QIO=y
CONFIG_ESPTOOLPY_FLASHFREQ_80M=y
CONFIG_COMPILER_OPTIMIZATION_PERF=y
CONFIG_SPIRAM=y
CONFIG_SPIRAM_MODE_HEX=y
CONFIG_SPIRAM_SPEED_250M=y
CONFIG_SPIRAM_ALLOW_STACK_EXTERNAL_MEMORY=y
CONFIG_SPIRAM_BOOT_INIT=y
CONFIG_ESP_DEFAULT_CPU_FREQ_MHZ_400=y
CONFIG_CACHE_L2_CACHE_128KB=y
CONFIG_CACHE_L2_CACHE_LINE_128B=y
CONFIG_FREERTOS_HZ=1000
CONFIG_ESP32P4_REV_MIN_301=y
CONFIG_ESP_CONSOLE_USB_SERIAL_JTAG=y
CONFIG_PARTITION_TABLE_OFFSET=0xa000
CONFIG_IDF_EXPERIMENTAL_FEATURES=y
```
