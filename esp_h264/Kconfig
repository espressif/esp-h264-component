## esp_h264/Kconfig
```kconfig
menu "ESP H264 Configuration"

    config ESP_H264_DECODER_IRAM
        bool "Place part of H264 decoder into IRAM"
        default "y"
        help 
            If this option is enabled, part of H264 decoder will be placed into IRAM,
            which will increase the size by approximately 22KB.

    config ESP_H264_DUAL_TASK
        bool "Enable dual task for H264 decoder"
        default "n"
        help
            If this option is enabled, H264 decoder will create two tasks to accelerate the decoding process.

    config ESP_H264_DUAL_TASK_CORE
        int "Task core ID for H264 decoder task"
        depends on ESP_H264_DUAL_TASK
        default 1
        range 0 1
        help
            The second task core ID for H264 decoder task.

    config ESP_H264_DUAL_TASK_PRIORITY
        int "Task priority for H264 decoder task"
        depends on ESP_H264_DUAL_TASK
        default 17
        range 1 22
        help
            The second task priority for H264 decoder task.

endmenu
```

## esp_h264/test_apps/sdkconfig.defaults.esp32s3
```kconfig
#
# Serial flasher config
#
CONFIG_ESPTOOLPY_FLASHMODE_QIO=y
CONFIG_ESPTOOLPY_FLASHFREQ_80M=y
CONFIG_ESPTOOLPY_FLASHFREQ_80M_DEFAULT=y
CONFIG_ESPTOOLPY_FLASHFREQ="80m"

#
# Compiler options
#
CONFIG_COMPILER_OPTIMIZATION_PERF=y

#
# ESP PSRAM
#
CONFIG_SPIRAM=y

#
# SPI RAM config
#
CONFIG_SPIRAM_MODE_OCT=y
CONFIG_SPIRAM_TYPE_AUTO=y
CONFIG_SPIRAM_ALLOW_STACK_EXTERNAL_MEMORY=y
CONFIG_SPIRAM_SPEED_80M=y
CONFIG_SPIRAM_SPEED=80
CONFIG_SPIRAM_BOOT_INIT=y

#
# ESP System Settings
#
CONFIG_ESP_DEFAULT_CPU_FREQ_MHZ_240=y
CONFIG_ESP_DEFAULT_CPU_FREQ_MHZ=240

#
# Cache config
#
CONFIG_ESP32S3_DATA_CACHE_64KB=y
CONFIG_ESP32S3_DATA_CACHE_SIZE=0x10000
CONFIG_ESP32S3_DATA_CACHE_8WAYS=y
CONFIG_ESP32S3_DCACHE_ASSOCIATED_WAYS=8
CONFIG_ESP32S3_DATA_CACHE_LINE_64B=y
CONFIG_ESP32S3_DATA_CACHE_LINE_SIZE=64

#
# Kernel
#
CONFIG_FREERTOS_HZ=1000
CONFIG_FREERTOS_ENABLE_BACKWARD_COMPATIBILITY=y

#
# ESP H264 Configuration
#
CONFIG_ESP_H264_DECODER_IRAM=y
```
